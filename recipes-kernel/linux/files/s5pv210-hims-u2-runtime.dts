// SPDX-License-Identifier: GPL-2.0
/* Normal runtime: Linux UBI and internal SD writable. Factory/BBT protected. */
#include "s5pv210-hims-u2-reboot-test.dts"
#include "s5pv210-hims-u2-pmic-bus.dtsi"
#include "s5pv210-hims-u2-bluetooth.dtsi"
#include "s5pv210-hims-u2-fm.dtsi"
#include "s5pv210-hims-u2-input.dtsi"
#include "s5pv210-hims-u2-braille.dtsi"
#include "s5pv210-hims-u2-battery.dtsi"
#include "s5pv210-hims-u2-usb-host-test.dtsi"
#include "s5pv210-hims-u2-external-sd.dtsi"
#include "s5pv210-hims-u2-suspend.dtsi"
#include "s5pv210-hims-u2-compass.dtsi"
#include "s5pv210-hims-u2-audio-input.dtsi"

/* Standalone boot must not wait for a host to drain USB serial output.
 * The explicit ttyGS0 maintenance shell remains independent of /dev/console.
 */
&{/chosen} {
    bootargs = "console=tty0 rdinit=/init loglevel=4 systemd.show_status=no clk_ignore_unused g_serial.iProduct=OpenH432-RAM g_serial.iSerialNumber=H432-RAM-TEST";
};

&{/nand@b0e00000} {
    hims,write-window = <0x00400000 0x1fb00000>;
};
&sdhci1 {
    /delete-property/ hims,read-only-probe;
};
&sdhci3 {
    /delete-property/ hims,read-only-probe;
};
