// SPDX-License-Identifier: GPL-2.0-only
/ {
	braille-display {
		compatible = "hims,h432b-braille";
		enable-gpios = <&gpj0 3 GPIO_ACTIVE_HIGH>;
		data-gpios = <&gpj1 5 GPIO_ACTIVE_HIGH>;
		clock-gpios = <&gpj1 4 GPIO_ACTIVE_HIGH>;
		latch-gpios = <&gpj4 1 GPIO_ACTIVE_HIGH>;
	};
};
