## conf/layer.conf
```bitbake
# SPDX-License-Identifier: MIT
BBPATH .= ":${LAYERDIR}"
BBFILES += "${LAYERDIR}/recipes-*/*/*.bb ${LAYERDIR}/recipes-*/*/*.bbappend"
BBFILE_COLLECTIONS += "fractalmicro_h432b"
BBFILE_PATTERN_fractalmicro_h432b = "^${LAYERDIR}/"
BBFILE_PRIORITY_fractalmicro_h432b = "6"
LAYERDEPENDS_fractalmicro_h432b = "core"
LAYERSERIES_COMPAT_fractalmicro_h432b = "wrynose"
```

## conf/machine/h432b.conf
```bitbake
# SPDX-License-Identifier: MIT
# HIMS BrailleSense U2 / H432B, Samsung S5PV210, 256 MiB RAM.
DEFAULTTUNE = "cortexa8hf-neon"
require conf/machine/include/arm/armv7a/tune-cortexa8.inc
require conf/machine/include/h432b-storage.inc
ARM_INSTRUCTION_SET = "arm"
MACHINE_FEATURES = "usbhost usbgadget alsa qemu-usermode"
MACHINE_FEATURES_OPTED_OUT = "rtc"
PREFERRED_PROVIDER_virtual/kernel = "linux-h432b-runtime"
PREFERRED_PROVIDER_virtual/bootloader = "u-boot-h432b"
KERNEL_IMAGETYPE = "zImage"
KERNEL_DEVICETREE = "samsung/s5pv210-hims-u2.dtb"
KERNEL_DTBVENDORED = "1"
SERIAL_CONSOLES = "115200;ttyGS0"
# Neither raw artifact is a factory update carrier.
UBOOT_MACHINE = "hims_u2_config"
UBOOT_ENTRYPOINT = "0x40008000"
UBOOT_LOADADDRESS = "0x40008000"
MACHINE_ESSENTIAL_EXTRA_RRECOMMENDS = ""
```
